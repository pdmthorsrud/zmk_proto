## app/boards/shields/proto/Kconfig.shield
```kconfig
# Copyright (c) 2020 Pete Johanson
# SPDX-License-Identifier: MIT

config SHIELD_PROTO_LEFT
    def_bool $(shields_list_contains,proto_left)

config SHIELD_PROTO_RIGHT
    def_bool $(shields_list_contains,proto_right)
```
